## firmware/boards/arm/bt_bike_light/Kconfig.board
```kconfig
# Copyright (c) 2024 Nordic Semiconductor ASA
# SPDX-License-Identifier: Apache-2.0

config BOARD_BT_BIKE_LIGHT
	bool "bt_bike_light"
	depends on SOC_NRF52832_QFAA
```

## firmware/boards/arm/bt_bike_light/Kconfig.defconfig
```kconfig
# Copyright (c) 2024 Nordic Semiconductor ASA
# SPDX-License-Identifier: Apache-2.0

if BOARD_BT_BIKE_LIGHT

config BOARD
	default "bt_bike_light"

config BT_CTLR
   default BT


endif
```
